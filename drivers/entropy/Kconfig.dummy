## drivers/entropy/Kconfig.dummy
```kconfig
# Copyright (c) 2022, Commonwealth Scientific and Industrial Research
# Organisation (CSIRO) ABN 41 687 119 230.
# SPDX-License-Identifier: Apache-2.0

config ENTROPY_DUMMY
	bool "Dummy driver"
	default y
	select ENTROPY_HAS_DRIVER
	help
	  Enable Random Number Generator Dummy
```

## dts/bindings/bluetooth/zephyr,dummy-entropy.yaml
```yaml
# Copyright (c) 2024, Nordic Semiconductor ASA
# SPDX-License-Identifier: Apache-2.0

description: |
    Dummy entropy

compatible: "zephyr,dummy-entropy"

include: base.yaml
```

## samples/bluetooth/hci_uart_async/boards/nrf54l15pdk_nrf54l15_cpuapp.conf
```kconfig
CONFIG_ASSERT=y

CONFIG_HW_STACK_PROTECTION=y

# CONFIG_CONSOLE=y
# CONFIG_UART_CONSOLE=y
# CONFIG_SERIAL=y
# CONFIG_LOG=y
# CONFIG_LOG_BUFFER_SIZE=4096
# CONFIG_LOG_BACKEND_UART=y
# CONFIG_LOG_BACKEND_SHOW_COLOR=y
# CONFIG_LOG_PROCESS_THREAD_STACK_SIZE=1024

# CONFIG_LOG_DEFAULT_LEVEL=4
# CONFIG_LOG=y

# Enable Direction Finding Feature: LlDdiAdvBv37C, LlDdiAdvBv39C, LlDdiAdvBv60C
# LL/CON/CEN/BV-150-C, LL/CON/CEN/BV-61-C, LL/CON/CEN/BV-62-C, LL/CON/CEN/BV-68-C, LL/CON/CEN/BV-83-C
# LL/CON/PER/BV-150-C, LL/CON/PER/BV-65-C, LL/CON/PER/BV-66-C, LL/CON/PER/BV-72-C, LL/CON/PER/BV-87-C
CONFIG_BT_CTLR_DF=y
CONFIG_BT_CTLR_DF_CONN_CTE_RSP=y

# To continue rest of the test executions even if nrf54 gets into fatal
CONFIG_RESET_ON_FATAL_ERROR=n
CONFIG_BT_CTLR_ASSERT_HANDLER=n

# For Moonlight, this provides correct clocks
CONFIG_CLOCK_CONTROL_NRF_K32SRC_SYNTH=y

CONFIG_LOG=y
```
